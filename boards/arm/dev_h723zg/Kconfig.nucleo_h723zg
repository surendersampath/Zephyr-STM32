## boards/arm/dev_h723zg/Kconfig.nucleo_h723zg
```kconfig
# Copyright (c) 2020 Alexander Kozhinov <AlexanderKozhinov@yandex.com>
# SPDX-License-Identifier: Apache-2.0

config BOARD_DEV_H723ZG
	select SOC_STM32H723XX
```
